## prj.conf
```kconfig
# Configure logging and debugging
CONFIG_LOG=y
CONFIG_LOG_BACKEND_RTT=y
CONFIG_LOG_BACKEND_UART=y
CONFIG_LOG_BUFFER_SIZE=4096
CONFIG_LOG_DEFAULT_LEVEL=3
CONFIG_USE_SEGGER_RTT=y
CONFIG_ASSERT=y
CONFIG_CONSOLE=y
CONFIG_UART_CONSOLE=y
CONFIG_DEBUG=y
CONFIG_DEBUG_OPTIMIZATIONS=y

# Configure Bluetooth
CONFIG_BT=y
CONFIG_BT_PERIPHERAL=y
CONFIG_BT_DEVICE_NAME="Nordic Clicker"
CONFIG_BT_DEVICE_APPEARANCE=384
CONFIG_BT_MAX_CONN=1
CONFIG_BT_LL_SOFTDEVICE=y

# Heap for FIFOs
CONFIG_HEAP_MEM_POOL_SIZE=2048

# Power management
CONFIG_PM=y
CONFIG_PM_DEVICE=y
CONFIG_POWEROFF=y
```

## prj_release.conf
```kconfig
CONFIG_LOG=n
CONFIG_PRINTK=n
CONFIG_BOOT_BANNER=n
CONFIG_EARLY_CONSOLE=n
CONFIG_USE_SEGGER_RTT=n
CONFIG_FAULT_DUMP=0
CONFIG_STACK_SENTINEL=y

# Build options
CONFIG_SIZE_OPTIMIZATIONS=y
CONFIG_OVERRIDE_FRAME_POINTER_DEFAULT=y
CONFIG_BUILD_OUTPUT_STRIPPED=y

# Configure Bluetooth
CONFIG_BT=y
CONFIG_BT_PERIPHERAL=y
CONFIG_BT_DEVICE_NAME="Nordic Clicker"
CONFIG_BT_DEVICE_APPEARANCE=384
CONFIG_BT_MAX_CONN=1
CONFIG_BT_LL_SOFTDEVICE=y

# Heap for FIFOs
CONFIG_HEAP_MEM_POOL_SIZE=2048

# Enable power off
CONFIG_POWEROFF=y
```

## src/main.c
```c
#include <zephyr/drivers/gpio.h>
#include <zephyr/drivers/uart.h>
#include <zephyr/kernel.h>
#include <zephyr/logging/log.h>

#include "battery.h"
#include "bluetooth.h"
#include "buttons.h"
#include "leds.h"
#include "speaker.h"

LOG_MODULE_REGISTER(app_main);

int main(void) {
    bool ok = true;
    ok &= bluetooth_init() == 0;

    if (!ok) {
        LOG_ERR("Initialization failed.");
        return 0;
    }

    LOG_INF("Starting main loop...");

    int i = 0;
    while (1) {
        // k_msleep(1000);
        LOG_INF("Still alive %d", i);
        ++i;

        // leds_play(LEDS_D2, LEDS_BREATHE, LEDS_RGB(100, 100, 0), 2, on_leds_finished);
        // speaker_play(SPEAKER_MELODY_ERROR, on_speaker_finished);
        // k_msleep(10000);

        k_msleep(1000);
        int mv = battery_get_voltage_mv();
        LOG_ERR("Battery voltage: %d mV", mv);

        // struct buttons_event_t event;
        // if (buttons_get_event(&event, K_SECONDS(1)) == 0) {
        //     LOG_INF("Button: %d, long: %d, shift: %d", event.button + 1, event.is_long_press,
        //             event.preceding_short_shift_presses);

        //     if (event.button == BUTTONS_BTN_3) {
        //         sys_poweroff();
        //     }
        // }
    }

    return 0;
}
```

## src/battery.c
```c
#include <zephyr/drivers/adc.h>
#include <zephyr/kernel.h>
#include <zephyr/logging/log.h>

LOG_MODULE_REGISTER(app_battery);

// Thread configuration
#define THREAD_STACK_SIZE 1024
#define THREAD_PRIORITY   10

// Timing configuration
#define SAMPLE_INTERVAL       K_SECONDS(1)
#define SAMPLE_AVERAGE_COUNT  4
#define OVERSAMPLING_EXPONENT 3  // Each sample is averaged from 2^OVERSAMPLING_EXPONENT conversion results

// ADC device
static const struct adc_dt_spec adc = ADC_DT_SPEC_GET(DT_PATH(zephyr_user));

// Semaphores and global state
static atomic_t avg_adc_reading;  // 0 initially until first read, -1 in case of an error

/*********************************************************************************************************************
 * PRIVATE FUNCTIONS
 *********************************************************************************************************************/

static bool init_adc() {
    if (!adc_is_ready_dt(&adc)) {
        LOG_ERR("ADC device is not ready");
        return false;
    }

    int err = adc_channel_setup_dt(&adc);
    if (err) {
        LOG_ERR("Failed to setup ADC channel: %d", err);
        return false;
    }

    return true;
}

static bool read_adc(int16_t *val) {
    struct adc_sequence seq = {0};

    int res = adc_sequence_init_dt(&adc, &seq);
    if (res) {
        LOG_ERR("Failed to initialize ADC sequence: %d", res);
        return false;
    }

    seq.buffer       = val;
    seq.buffer_size  = sizeof(*val);
    seq.oversampling = OVERSAMPLING_EXPONENT;

    res = adc_read_dt(&adc, &seq);
    if (res) {
        LOG_ERR("Failed to read ADC: %d", res);
        return false;
    }

    return true;
}

/*********************************************************************************************************************
 * THREADS
 *********************************************************************************************************************/
static void battery_thread_fn() {
    if (!init_adc()) {
        return;
    }

    // Create a buffer for the samples
    int16_t samples[SAMPLE_AVERAGE_COUNT];
    int sample_idx = 0;

    // First reading; set all samples to the same first reading
    int16_t sample;
    if (!read_adc(&sample)) goto error;
    atomic_set(&avg_adc_reading, (int32_t)sample);

    for (int i = 0; i < SAMPLE_AVERAGE_COUNT; ++i) {
        samples[i] = sample;
    }

    LOG_INF("Battery module initialized OK; waiting for commands");

    // Main loop, periodically reading the battery voltage
    while (true) {
        k_sleep(SAMPLE_INTERVAL);

        // Read the ADC into the next sample slot
        if (!read_adc(&samples[sample_idx])) goto error;
        sample_idx = (sample_idx + 1) % SAMPLE_AVERAGE_COUNT;

        // Update the average ADC reading
        int32_t sum = 0;
        for (int i = 0; i < SAMPLE_AVERAGE_COUNT; ++i) {
            sum += samples[i];
        }

        atomic_set(&avg_adc_reading, sum / SAMPLE_AVERAGE_COUNT);
    }

error:
    atomic_set(&avg_adc_reading, -1);
    LOG_ERR("Failed to read ADC; battery module disabled");
}

K_THREAD_DEFINE(battery_thread_id, THREAD_STACK_SIZE, battery_thread_fn, NULL, NULL, NULL, THREAD_PRIORITY, 0, 0);

/*********************************************************************************************************************
 * PUBLIC FUNCTIONS
 *********************************************************************************************************************/
int battery_get_voltage_mv() {
    // Get the reading from the battery thread, if it is 0, we are still initializing
    int32_t raw = atomic_get(&avg_adc_reading);
    while (raw == 0) {
        k_sleep(K_MSEC(1));
        raw = atomic_get(&avg_adc_reading);
    }

    // Convert the ADC reading to millivolts
    int32_t mv = raw;
    int res    = adc_raw_to_millivolts_dt(&adc, &mv);
    if (res) {
        LOG_ERR("Failed to convert ADC raw value to millivolts: %d", res);
        return false;
    }

    return (int)mv;
}

int battery_get_soc_percent(int bat_voltage_mv) {
    if (bat_voltage_mv > 3000) {
        return 100;
    } else if (bat_voltage_mv > 2900) {
        return 50;
    } else if (bat_voltage_mv > 2800) {
        return 5;
    } else if (bat_voltage_mv < 2500) {
        return 0;
    }
}
```

## src/battery.h
```c
#ifndef BATTERY_H
#define BATTERY_H

/**
 * @brief Gets the latest measurement of the battery voltage.
 *
 * @retval >0 Battery voltage in mV.
 * @retval -1 In case of an error.
 */
int battery_get_voltage_mv();

/**
 * @brief Estimates the remaining capacity of the CR2032 battery as a percentage.
 *
 * This is a (very) rough estimate based on the voltage reading.
 *
 * @param bat_voltage_mv The battery voltage in mV.
 * @retval 0..100 Remaining capacity in percentage.
 */
int battery_get_soc_percent(int bat_voltage_mv);

#endif  // BATTERY_H
```

## src/bluetooth.c
```c
#include "bluetooth.h"

#include <zephyr/bluetooth/bluetooth.h>
#include <zephyr/bluetooth/gatt.h>
#include <zephyr/bluetooth/hci.h>
#include <zephyr/bluetooth/uuid.h>
#include <zephyr/kernel.h>
#include <zephyr/logging/log.h>

LOG_MODULE_REGISTER(app_bluetooth);

// UUIDs
#define BT_UUID_REMOTE_SERV_VAL BT_UUID_128_ENCODE(0xe9ea0001, 0xe19b, 0x482d, 0x9293, 0xc7907585fc48)

// Advertising data
static const struct bt_data ad[] = {
    BT_DATA_BYTES(BT_DATA_FLAGS, (BT_LE_AD_GENERAL | BT_LE_AD_NO_BREDR)),
    BT_DATA(BT_DATA_NAME_COMPLETE, CONFIG_BT_DEVICE_NAME, (sizeof(CONFIG_BT_DEVICE_NAME) - 1))};

static const struct bt_data sd[] = {
    BT_DATA_BYTES(BT_DATA_UUID128_ALL, BT_UUID_REMOTE_SERV_VAL),
};

// Semaphores
K_SEM_DEFINE(bluetooth_ready, 1, 1);

/*********************************************************************************************************************
 * PRIVATE FUNCTIONS
 *********************************************************************************************************************/
static void on_bluetooth_ready(int err) {
    if (err) {
        LOG_ERR("on_bluetooth_ready() called with error %d", err);
    }

    k_sem_give(&bluetooth_ready);
}

/*********************************************************************************************************************
 * PUBLIC FUNCTIONS
 *********************************************************************************************************************/
int bluetooth_init() {
    LOG_INF("Initializing Bluetooth...");

    int err = bt_enable(on_bluetooth_ready);
    if (err) {
        LOG_ERR("bt_enable() returned %d", err);
        return err;
    }

    k_sem_take(&bluetooth_ready, K_FOREVER);

    err = bt_le_adv_start(BT_LE_ADV_CONN, ad, ARRAY_SIZE(ad), sd, ARRAY_SIZE(sd));
    if (err) {
        LOG_ERR("bt_le_adv_start() returned %d", err);
        return err;
    }

    LOG_INF("Bluetooth initialized OK");

    return 0;
}
```

## src/bluetooth.h
```c
/**
 * @brief Initialize Bluetooth and start advertising.
 *
 * @retval 0 If successful.
 * @retval <0 Error code if initialization failed.
 */
int bluetooth_init();
```

## src/buttons.c
```c
#include "buttons.h"

#include <hal/nrf_gpio.h>
#include <zephyr/drivers/gpio.h>
#include <zephyr/logging/log.h>

LOG_MODULE_REGISTER(app_buttons);

// Thread configuration
#define THREAD_STACK_SIZE 1024
#define THREAD_PRIORITY   6

// Long press timing; the _ON_WAKEUP threshold is lower to account for the boot time of the device
#define LONG_PRESS_THRESHOLD           K_MSEC(2000)
#define LONG_PRESS_THRESHOLD_ON_WAKEUP K_MSEC(1500)

// GPIO devices
#define BUTTON_DEF(node_label)                                                \
    (struct button_t) {                                                       \
        .spec = GPIO_DT_SPEC_GET(DT_NODELABEL(node_label), gpios),            \
        .port = DT_PROP(DT_GPIO_CTLR(DT_NODELABEL(node_label), gpios), port), \
    }

struct button_t {
    const struct gpio_dt_spec spec;
    const int port;
    struct gpio_callback cb_data;
};

static struct button_t buttons[] = {
    BUTTON_DEF(button_1),  // BUTTONS_BTN_1
    BUTTON_DEF(button_2),  // BUTTONS_BTN_2
    BUTTON_DEF(button_3),  // BUTTONS_BTN_3
    BUTTON_DEF(button_4),  // BUTTONS_BTN_4
    BUTTON_DEF(button_5),  // BUTTONS_BTN_5
    BUTTON_DEF(button_6),  // BUTTONS_BTN_SHIFT
};

// FIFO for button events (for communication with user code)
struct buttons_fifo_item_t {
    void *fifo_reserved;
    struct buttons_event_t event;
};

K_FIFO_DEFINE(buttons_fifo);

// Sempahore for the ISR to signal the thread to check for button presses/releases
K_SEM_DEFINE(buttons_sem, 0, 1);

// Status of the LATCH registers at startup to check which button triggered exit from System OFF
static uint32_t gpio_latch_at_startup[2] = {0};

/*********************************************************************************************************************
 * STARTUP HOOKS
 *********************************************************************************************************************/
static int detect_wakup_latch() {
    nrf_gpio_latches_read(0, ARRAY_SIZE(gpio_latch_at_startup), gpio_latch_at_startup);
    return 0;
}

SYS_INIT(detect_wakup_latch, PRE_KERNEL_1, 0);

/*********************************************************************************************************************
 * INTERRUPT HANDLERS
 *********************************************************************************************************************/
static void button_pressed(const struct device *port, struct gpio_callback *cb, gpio_port_pins_t pins) {
    // Signal the thread to check for button presses/releases
    k_sem_give(&buttons_sem);
}

/*********************************************************************************************************************
 * PRIVATE FUNCTIONS
 *********************************************************************************************************************/
static bool setup_gpios_and_interrupts() {
    for (int i = 0; i < ARRAY_SIZE(buttons); i++) {
        struct button_t *btn = &buttons[i];

        // Check that the GPIO is ready
        if (!gpio_is_ready_dt(&btn->spec)) {
            LOG_ERR("GPIO for button %d is not ready", i + 1);
            return false;
        }

        // Configure GPIO as input
        int res = gpio_pin_configure_dt(&btn->spec, GPIO_INPUT);
        if (res != 0) {
            LOG_ERR("Failed to configure GPIO for button %d as input: %d:", i + 1, res);
            return false;
        }

        // Setup the interrupt handler
        res = gpio_pin_interrupt_configure_dt(&btn->spec, GPIO_INT_EDGE_BOTH);
        if (res != 0) {
            LOG_ERR("Failed to configure interrupt for button %d: %d", i + 1, res);
            return false;
        }

        gpio_init_callback(&btn->cb_data, button_pressed, BIT(btn->spec.pin));
        res = gpio_add_callback_dt(&btn->spec, &btn->cb_data);
        if (res != 0) {
            LOG_ERR("Failed to add callback for button %d: %d", i + 1, res);
            return false;
        }
    }

    LOG_INF("Buttons module initialized OK; waiting for button presses");

    return true;
}

static bool is_button_pressed(const struct button_t *btn) {
    int res = gpio_pin_get_dt(&btn->spec);
    if (res < 0) {
        LOG_ERR("Failed to get GPIO state for button: %d", res);
        return false;
    }

    return (res == 1);
}

/*********************************************************************************************************************
 * THREADS
 *********************************************************************************************************************/
static void buttons_thread_fn() {
    if (!setup_gpios_and_interrupts()) {
        return;
    }

    const struct button_t *pressed_button = NULL;
    k_timepoint_t long_press_exp_time     = sys_timepoint_calc(K_FOREVER);
    int preceding_short_shift_presses     = 0;

    LOG_INF("Buttons module initialized OK; waiting for button presses");

    // Check if any button was pressed at startup
    for (int i = 0; i < ARRAY_SIZE(buttons); i++) {
        const struct button_t *btn = &buttons[i];
        if (gpio_latch_at_startup[btn->port] & BIT(btn->spec.pin)) {
            long_press_exp_time = sys_timepoint_calc(LONG_PRESS_THRESHOLD_ON_WAKEUP);
            pressed_button      = btn;
            LOG_INF("Button %d was pressed at startup", i + 1);
            break;
        }
    }

    if (pressed_button == NULL) {
        LOG_INF("No button was pressed at startup");
    }

    // Main loop, waiting for button presses/releases
    while (true) {
        // If, until now, no button has been pressed, we check if any button is pressed now
        if (pressed_button == NULL) {
            for (int i = 0; i < ARRAY_SIZE(buttons); i++) {
                const struct button_t *btn = &buttons[i];

                if (is_button_pressed(btn)) {
                    long_press_exp_time = sys_timepoint_calc(LONG_PRESS_THRESHOLD);
                    pressed_button      = btn;
                    break;
                }
            }
        }

        // Otherwise, if, until now, a button has been pressed, we check if that button has now been released,
        // and we send the corresponding event
        else {
            bool is_pressed    = is_button_pressed(pressed_button);
            bool is_long_press = sys_timepoint_expired(long_press_exp_time);

            if (!is_pressed || is_long_press) {
                // Generate the event
                struct buttons_fifo_item_t *item = k_malloc(sizeof(struct buttons_fifo_item_t));
                item->fifo_reserved              = NULL;
                item->event.button               = (enum buttons_button_t)(ARRAY_INDEX(buttons, pressed_button));
                item->event.is_long_press        = is_long_press;
                item->event.preceding_short_shift_presses = preceding_short_shift_presses;
                LOG_INF("New button event: button=%d, long=%d, pssp=%d", item->event.button + 1,
                        item->event.is_long_press, item->event.preceding_short_shift_presses);
                k_fifo_put(&buttons_fifo, item);

                // Update the state
                if (pressed_button == &buttons[BUTTONS_BTN_SHIFT] && !is_long_press) {
                    preceding_short_shift_presses++;
                } else {
                    preceding_short_shift_presses = 0;
                }

                pressed_button      = NULL;
                long_press_exp_time = sys_timepoint_calc(K_FOREVER);
            }
        }

        // Wait for the signal from the ISR
        k_sem_take(&buttons_sem, sys_timepoint_timeout(long_press_exp_time));
    }
}

K_THREAD_DEFINE(buttons_thread_id, THREAD_STACK_SIZE, buttons_thread_fn, NULL, NULL, NULL, THREAD_PRIORITY, 0, 0);

/*********************************************************************************************************************
 * PUBLIC FUNCTIONS
 *********************************************************************************************************************/
int buttons_get_event(struct buttons_event_t *event, k_timeout_t timeout) {
    struct buttons_fifo_item_t *item = k_fifo_get(&buttons_fifo, timeout);
    if (item == NULL) {
        return -ETIMEDOUT;
    }

    *event = item->event;
    k_free(item);
    return 0;
}
```

## src/buttons.h
```c
#ifndef BLUETOOTH_H
#define BLUETOOTH_H

/**
 * @brief Initialize the button GPIOs and related interrupts.
 *
 * @retval 0 If successful.
 * @retval <0 Error code if initialization failed.
 */
int buttons_init();

#endif  // BLUETOOTH_H
```

## src/leds.h
```c
#ifndef LEDS_H
#define LEDS_H

#include <stdbool.h>
#include <stdint.h>

#define LEDS_RGB(r, g, b) ((struct leds_color_t){r, g, b})

enum leds_led_t {
    LEDS_D1,
    LEDS_D2,
};

enum leds_pattern_t {
    LEDS_SOLID,
    LEDS_FLASH,
    LEDS_BREATHE,
};

struct leds_color_t {
    uint8_t r;
    uint8_t g;
    uint8_t b;
};

typedef void (*leds_finished_cb_t)(bool aborted);

/**
 * @brief Play a pattern on an LED.
 *
 * If a pattern is currently still playing on any LED, it will be aborted and the pattern finished callback will be
 * called before playing the new pattern. Note that if the LEDS_SOLID pattern is selected or reps is -1, the callback
 * will only be called once a new pattern is played. You can only play a pattern on a single LED at a time.
 *
 * @param led The LED to play the pattern on.
 * @param pattern The pattern to play.
 * @param color The color of the pattern.
 * @param reps The number of times to repeat the pattern. Set to -1 to repeat indefinitely and 0 to switch LEDs off.
 * @param cb The callback to call when the pattern (with all its repetitions) has finished playing. Can be set to NULL;
 *
 * @retval 0 If successful.
 * @retval <0 Error code if playing the pattern failed.
 */
int leds_play(enum leds_led_t led, enum leds_pattern_t pattern, struct leds_color_t color, int reps,
              leds_finished_cb_t cb);

/**
 * @brief Stops the pattern currently playing, if there is any.
 *
 * This is a convenience function that calls leds_play() with reps set to 0.
 *
 * @retval 0 If successful.
 * @retval <0 Error code if stopping the pattern failed.
 */
int leds_off();

#endif  // LEDS_H
```

## src/speaker.c
```c
#include "speaker.h"

#include <zephyr/drivers/pwm.h>
#include <zephyr/kernel.h>
#include <zephyr/logging/log.h>

LOG_MODULE_REGISTER(app_speaker);

// Thread configuration
#define THREAD_STACK_SIZE 1024
#define THREAD_PRIORITY   4

// Macros for readability
#define MELODY_END {.note = 0, .length = 0}

// Notes in Hz
enum note_t {
    REST = 0,
    C4   = 262,
    Db4  = 277,
    D4   = 294,
    Eb4  = 311,
    E4   = 330,
    F4   = 349,
    Gb4  = 370,
    G4   = 392,
    Ab4  = 415,
    A4   = 440,
    Bb4  = 466,
    B4   = 494,
    C5   = 523,
    Db5  = 554,
    D5   = 587,
    Eb5  = 622,
    E5   = 659,
    F5   = 698,
    Gb5  = 740,
    G5   = 784,
    Ab5  = 831,
    A5   = 880,
    Bb5  = 932,
    B5   = 988,
    C6   = 1046,
    Db6  = 1109,
    D6   = 1175,
    Eb6  = 1245,
    E6   = 1319,
    F6   = 1397,
    Gb6  = 1480,
    G6   = 1568,
    Ab6  = 1661,
    A6   = 1760,
    Bb6  = 1865,
    B6   = 1976,
    C7   = 2093,
    Db7  = 2217,
    D7   = 2349,
    Eb7  = 2489,
    E7   = 2637,
    F7   = 2794,
    Gb7  = 2960,
    G7   = 3136,
    Ab7  = 3322,
    A7   = 3520,
    Bb7  = 3729,
    B7   = 3951,
    C8   = 4186,
    Db8  = 4435,
    D8   = 4699,
    Eb8  = 4978,
    E8   = 5274,
    F8   = 5588,
    Gb8  = 5920,
    G8   = 6272,
    Ab8  = 6645,
    A8   = 7040,
    Bb8  = 7459,
    B8   = 7902,
};

// Note lengths in ms
enum note_length_t {
    SIXTEENTH = 38,
    EIGTH     = 75,
    QUARTER   = 150,
    HALF      = 300,
    WHOLE     = 600,
};

// A note and its lengths within a melody
struct melody_note_t {
    uint16_t note;
    uint16_t length;
};

// PWM device connected to the speaker
static const struct device *pwm = DEVICE_DT_GET(DT_NODELABEL(pwm0));

// FIFO for communicating with the speaker thread
struct play_cmd_t {
    void *fifo_reserved;
    const struct melody_note_t *melody;
    speaker_finished_cb_t cb;
};

K_FIFO_DEFINE(speaker_play_cmd_fifo);

/*********************************************************************************************************************
 * PRIVATE FUNCTIONS
 *********************************************************************************************************************/
static const struct melody_note_t *get_melody(enum speaker_melody_t melody) {
    switch (melody) {
        case SPEAKER_MELODY_SUCCESS: {
            static struct melody_note_t mel[] = {
                {.note = C5,   .length = QUARTER}, //
                {.note = REST, .length = EIGTH  }, //
                {.note = C5,   .length = QUARTER}, //
                {.note = Bb4,  .length = QUARTER}, //
                {.note = C5,   .length = QUARTER}, //
                {.note = REST, .length = QUARTER}, //
                {.note = G4,   .length = QUARTER}, //
                {.note = REST, .length = QUARTER}, //
                {.note = G4,   .length = QUARTER}, //
                {.note = C5,   .length = QUARTER}, //
                {.note = F5,   .length = QUARTER}, //
                {.note = E5,   .length = QUARTER}, //
                {.note = C5,   .length = QUARTER}, //
                MELODY_END,
            };
            return mel;
        }

        case SPEAKER_MELODY_ERROR: {
            static struct melody_note_t mel[] = {
                {.note = E6,   .length = QUARTER}, //
                {.note = REST, .length = EIGTH  }, //
                {.note = E6,   .length = QUARTER}, //
                {.note = REST, .length = QUARTER}, //
                {.note = E6,   .length = QUARTER}, //
                {.note = REST, .length = QUARTER}, //
                {.note = C6,   .length = QUARTER}, //
                {.note = E6,   .length = HALF   }, //
                {.note = G6,   .length = HALF   }, //
                {.note = REST, .length = QUARTER}, //
                {.note = G4,   .length = WHOLE  }, //
                {.note = REST, .length = WHOLE  }, //
                {.note = C6,   .length = HALF   }, //
                {.note = REST, .length = QUARTER}, //
                {.note = G5,   .length = HALF   }, //
                {.note = REST, .length = QUARTER}, //
                {.note = E5,   .length = HALF   }, //
                {.note = REST, .length = QUARTER}, //
                {.note = A5,   .length = QUARTER}, //
                {.note = REST, .length = QUARTER}, //
                {.note = B5,   .length = QUARTER}, //
                {.note = REST, .length = QUARTER}, //
                {.note = Bb5,  .length = QUARTER}, //
                {.note = A5,   .length = HALF   }, //
                {.note = G5,   .length = QUARTER}, //
                {.note = E6,   .length = QUARTER}, //
                {.note = G6,   .length = QUARTER}, //
                {.note = A6,   .length = HALF   }, //
                {.note = F6,   .length = QUARTER}, //
                {.note = G6,   .length = QUARTER}, //
                {.note = REST, .length = QUARTER}, //
                {.note = E6,   .length = QUARTER}, //
                {.note = REST, .length = QUARTER}, //
                {.note = C6,   .length = QUARTER}, //
                {.note = D6,   .length = QUARTER}, //
                {.note = B5,   .length = QUARTER}, //
                MELODY_END,
            };
            return mel;
        }

        case SPEAKER_MELODY_LOW_BATTERY: {
            static struct melody_note_t mel[] = {
                {.note = C6,   .length = QUARTER}, //
                {.note = REST, .length = 100    }, //
                {.note = G5,   .length = 100    }, //
                {.note = A5,   .length = 100    }, //
                {.note = Bb5,  .length = 100    }, //
                {.note = REST, .length = 100    }, //
                {.note = Bb5,  .length = 100    }, //
                {.note = REST, .length = QUARTER}, //
                {.note = C5,   .length = HALF   }, //
                {.note = REST, .length = HALF   }, //
                {.note = REST, .length = QUARTER}, //
                {.note = C6,   .length = QUARTER}, //
                MELODY_END,
            };
            return mel;
        }

        default:
            LOG_ERR("Invalid melody: %d", melody);
            return NULL;
    }
}

static bool set_speaker_frequency(uint32_t frequency) {
    // Calculate the period and pulse length from the given frequency
    uint32_t period;
    uint32_t pulse;

    if (frequency == 0) {
        period = PWM_HZ(1);
        pulse  = 0;
    } else {
        period = PWM_HZ(frequency);
        pulse  = period / 2;
    }

    // First, stop the PWM channels (otherwise we'll get an error when changing the period)
    int res;
    res = pwm_set(pwm, 0, 1, 0, PWM_POLARITY_NORMAL);
    if (res < 0) goto error;

    res = pwm_set(pwm, 1, 1, 0, PWM_POLARITY_NORMAL);
    if (res < 0) goto error;

    // Now set the period and pulse length according to the requested frequency
    // (we run the two channels out-of-phase to increase the volume)
    res = pwm_set(pwm, 0, period, pulse, PWM_POLARITY_NORMAL);
    if (res < 0) goto error;

    res = pwm_set(pwm, 1, period, pulse, PWM_POLARITY_INVERTED);
    if (res < 0) goto error;

    return true;

error:
    LOG_ERR("Failed to set PWM parameters: %d", res);
    return false;
}

static int put_play_cmd(const struct melody_note_t *melody, speaker_finished_cb_t cb) {
    struct play_cmd_t *cmd = k_malloc(sizeof(struct play_cmd_t));
    if (!cmd) {
        LOG_ERR("Unable to allocate FIFO data item from heap");
        return -ENOMEM;
    }

    cmd->fifo_reserved = NULL;
    cmd->melody        = melody;
    cmd->cb            = cb;

    k_fifo_put(&speaker_play_cmd_fifo, cmd);

    return 0;
}

/*********************************************************************************************************************
 * THREADS
 *********************************************************************************************************************/
static void speaker_thread_fn() {
    if (!device_is_ready(pwm)) {
        LOG_ERR("PWM device is not ready");
        return;
    }

    LOG_INF("Speaker module initialized OK; waiting for commands");

    const struct melody_note_t *next_note = NULL;
    k_timepoint_t next_note_time          = sys_timepoint_calc(K_FOREVER);
    speaker_finished_cb_t finished_cb     = NULL;

    // Main loop, executing commands and playing melodies
    while (true) {
        // Wait for a new play command or until the next note time has been reached
        k_timeout_t timeout    = sys_timepoint_timeout(next_note_time);
        struct play_cmd_t *cmd = k_fifo_get(&speaker_play_cmd_fifo, timeout);

        // Play the next note in the melody if it's time or stop the melody if it's finished
        if (sys_timepoint_expired(next_note_time)) {
            // Play the next note
            if (next_note && (next_note->note != 0 || next_note->length != 0)) {
                set_speaker_frequency(next_note->note);
                next_note_time = sys_timepoint_calc(K_MSEC(next_note->length));
                next_note++;
            }
            // Melody is finished
            else {
                set_speaker_frequency(0);
                next_note      = NULL;
                next_note_time = sys_timepoint_calc(K_FOREVER);

                if (finished_cb) {
                    finished_cb(false);
                    finished_cb = NULL;
                }
            }
        }

        // If we didn't receive a command, wait for the next one
        if (!cmd) {
            continue;
        }

        // If a melody is currently playing, call the finished callback
        if (next_note) {
            next_note      = NULL;
            next_note_time = sys_timepoint_calc(K_NO_WAIT);

            if (finished_cb) {
                finished_cb(true);
                finished_cb = NULL;
            }
        }

        // If the command is not a stop-command, start playing the new melody
        if (cmd->melody) {
            next_note      = cmd->melody;
            next_note_time = sys_timepoint_calc(K_NO_WAIT);
            finished_cb    = cmd->cb;
        }

        // Free the command (it was allocated in speaker_play())
        k_free(cmd);
    }
}

K_THREAD_DEFINE(speaker_thread_id, THREAD_STACK_SIZE, speaker_thread_fn, NULL, NULL, NULL, THREAD_PRIORITY, 0, 0);

/*********************************************************************************************************************
 * PUBLIC FUNCTIONS
 *********************************************************************************************************************/
int speaker_play(enum speaker_melody_t melody, speaker_finished_cb_t cb) {
    return put_play_cmd(get_melody(melody), cb);
}

int speaker_off() {
    return put_play_cmd(NULL, NULL);
}
```

## src/speaker.h
```c
#ifndef SPEAKER_H
#define SPEAKER_H

#include <stdbool.h>
#include <stdint.h>

// Resonant frequency of the speaker in Hz (from the datasheet)
#define SPEAKER_RESONANT_FREQUENCY 4100

enum speaker_melody_t {
    SPEAKER_MELODY_SUCCESS,
    SPEAKER_MELODY_ERROR,
    SPEAKER_MELODY_LOW_BATTERY,
};

typedef void (*speaker_finished_cb_t)(bool aborted);

/**
 * @brief Play a melody on the speaker.
 *
 * If a melody is currently still playing, it will be aborted and the melody finished callback will be called before
 * playing the new melody.
 *
 * @param melody The melody to play.
 * @param cb The callback to call when the melody has finished playing. Can be set to NULL.
 *
 * @retval 0 If successful.
 * @retval <0 Error code if playing the melody failed.
 */
int speaker_play(enum speaker_melody_t melody, speaker_finished_cb_t cb);

/**
 * @brief Stops the melody currently playing, if there is any.
 *
 * @retval 0 If successful.
 * @retval <0 Error code if stopping the melody failed.
 */
int speaker_off();

#endif  // SPEAKER_H
```
