## CMakeLists.txt
```
cmake_minimum_required(VERSION 3.20.0)
find_package(Zephyr REQUIRED HINTS $ENV{ZEPHYR_BASE})

project(app)

target_sources(app PRIVATE
    src/services/battery_svc.c
    src/services/config_svc.c
    src/battery.c
    src/bluetooth.c
    src/buttons.c
    src/config.c
    src/leds.c
    src/main.c
    src/speaker.c
)
```

## prj.conf
```kconfig
# Configure logging and debugging
CONFIG_LOG=y
CONFIG_LOG_BACKEND_RTT=y
CONFIG_LOG_BACKEND_UART=y
CONFIG_LOG_BUFFER_SIZE=4096
CONFIG_LOG_DEFAULT_LEVEL=3
CONFIG_USE_SEGGER_RTT=y
CONFIG_ASSERT=y
CONFIG_CONSOLE=y
CONFIG_UART_CONSOLE=y
CONFIG_DEBUG=y
CONFIG_DEBUG_OPTIMIZATIONS=y

# Configure Bluetooth
CONFIG_BT=y
CONFIG_BT_PERIPHERAL=y
CONFIG_BT_DEVICE_NAME="Nordic Clicker"
CONFIG_BT_DEVICE_APPEARANCE=384
CONFIG_BT_MAX_CONN=1
CONFIG_BT_LL_SOFTDEVICE=y
CONFIG_BT_BAS=y

# Heap for FIFOs
CONFIG_HEAP_MEM_POOL_SIZE=2048

# Power management
CONFIG_PM=y
CONFIG_PM_DEVICE=y
CONFIG_POWEROFF=y

# ADC for measuring battery voltage
CONFIG_ADC=y
CONFIG_ADC_NRFX_SAADC=y

# Non-volatile storage
CONFIG_FLASH=y
CONFIG_NVS=y
CONFIG_MPU_ALLOW_FLASH_WRITE=y
```

## prj_release.conf
```kconfig
CONFIG_LOG=n
CONFIG_PRINTK=n
CONFIG_BOOT_BANNER=n
CONFIG_EARLY_CONSOLE=n
CONFIG_USE_SEGGER_RTT=n
CONFIG_FAULT_DUMP=0
CONFIG_STACK_SENTINEL=y

# Build options
CONFIG_SIZE_OPTIMIZATIONS=y
CONFIG_OVERRIDE_FRAME_POINTER_DEFAULT=y
CONFIG_BUILD_OUTPUT_STRIPPED=y

# Configure Bluetooth
CONFIG_BT=y
CONFIG_BT_PERIPHERAL=y
CONFIG_BT_DEVICE_NAME="Nordic Clicker"
CONFIG_BT_DEVICE_APPEARANCE=384
CONFIG_BT_MAX_CONN=1
CONFIG_BT_LL_SOFTDEVICE=y

# Heap for FIFOs
CONFIG_HEAP_MEM_POOL_SIZE=2048

# Enable power off
CONFIG_POWEROFF=y

# Non-volatile storage
CONFIG_FLASH=y
CONFIG_NVS=y
CONFIG_MPU_ALLOW_FLASH_WRITE=y
```

## src/main.c
```c
#include <zephyr/drivers/gpio.h>
#include <zephyr/drivers/uart.h>
#include <zephyr/kernel.h>
#include <zephyr/logging/log.h>

#include "battery.h"
#include "bluetooth.h"
#include "buttons.h"
#include "config.h"
#include "leds.h"
#include "speaker.h"

LOG_MODULE_REGISTER(app_main);

int main(void) {
    bool ok = true;
    ok &= bluetooth_init() == 0;

    if (!ok) {
        LOG_ERR("Initialization failed.");
        return 0;
    }

    LOG_INF("Starting main loop...");

    int i = 0;
    while (1) {
        // k_msleep(1000);
        LOG_INF("Still alive %d", i);
        ++i;

        // leds_play(LEDS_D2, LEDS_BREATHE, LEDS_RGB(100, 100, 0), 2, on_leds_finished);
        // speaker_play(SPEAKER_MELODY_ERROR, on_speaker_finished);
        // k_msleep(10000);

        k_msleep(1000);
        // int mv = battery_get_voltage_mv();
        // LOG_ERR("Battery voltage: %d mV", mv);

        // struct buttons_event_t event;
        // if (buttons_get_event(&event, K_SECONDS(1)) == 0) {
        //     LOG_INF("Button: %d, long: %d, shift: %d", event.button + 1, event.is_long_press,
        //             event.preceding_short_shift_presses);

        //     if (event.button == BUTTONS_BTN_3) {
        //         sys_poweroff();
        //     }
        // }
    }

    return 0;
}
```

## src/battery.c
```c
#include <zephyr/drivers/adc.h>
#include <zephyr/kernel.h>
#include <zephyr/logging/log.h>

LOG_MODULE_REGISTER(app_battery);

// Thread configuration
#define THREAD_STACK_SIZE 1024
#define THREAD_PRIORITY   10

// Timing configuration
#define SAMPLE_INTERVAL       K_SECONDS(1)
#define SAMPLE_AVERAGE_COUNT  4
#define OVERSAMPLING_EXPONENT 3  // Each sample is averaged from 2^OVERSAMPLING_EXPONENT conversion results

// ADC device
static const struct adc_dt_spec adc = ADC_DT_SPEC_GET(DT_PATH(zephyr_user));

// Semaphores and global state
static atomic_t avg_adc_reading;  // 0 initially until first read, -1 in case of an error

/*********************************************************************************************************************
 * PRIVATE FUNCTIONS
 *********************************************************************************************************************/

static bool init_adc() {
    if (!adc_is_ready_dt(&adc)) {
        LOG_ERR("ADC device is not ready");
        return false;
    }

    int err = adc_channel_setup_dt(&adc);
    if (err) {
        LOG_ERR("Failed to setup ADC channel: %d", err);
        return false;
    }

    return true;
}

static bool read_adc(int16_t *val) {
    struct adc_sequence seq = {0};

    int res = adc_sequence_init_dt(&adc, &seq);
    if (res) {
        LOG_ERR("Failed to initialize ADC sequence: %d", res);
        return false;
    }

    seq.buffer       = val;
    seq.buffer_size  = sizeof(*val);
    seq.oversampling = OVERSAMPLING_EXPONENT;

    res = adc_read_dt(&adc, &seq);
    if (res) {
        LOG_ERR("Failed to read ADC: %d", res);
        return false;
    }

    return true;
}

/*********************************************************************************************************************
 * THREADS
 *********************************************************************************************************************/
static void battery_thread_fn() {
    if (!init_adc()) {
        return;
    }

    // Create a buffer for the samples
    int16_t samples[SAMPLE_AVERAGE_COUNT];
    int sample_idx = 0;

    // First reading; set all samples to the same first reading
    int16_t sample;
    if (!read_adc(&sample)) goto error;
    atomic_set(&avg_adc_reading, (int32_t)sample);

    for (int i = 0; i < SAMPLE_AVERAGE_COUNT; ++i) {
        samples[i] = sample;
    }

    LOG_INF("Battery module initialized OK; waiting for commands");

    // Main loop, periodically reading the battery voltage
    while (true) {
        k_sleep(SAMPLE_INTERVAL);

        // Read the ADC into the next sample slot
        if (!read_adc(&samples[sample_idx])) goto error;
        sample_idx = (sample_idx + 1) % SAMPLE_AVERAGE_COUNT;

        // Update the average ADC reading
        int32_t sum = 0;
        for (int i = 0; i < SAMPLE_AVERAGE_COUNT; ++i) {
            sum += samples[i];
        }

        atomic_set(&avg_adc_reading, sum / SAMPLE_AVERAGE_COUNT);
    }

error:
    atomic_set(&avg_adc_reading, -1);
    LOG_ERR("Failed to read ADC; battery module disabled");
}

K_THREAD_DEFINE(battery_thread_id, THREAD_STACK_SIZE, battery_thread_fn, NULL, NULL, NULL, THREAD_PRIORITY, 0, 0);

/*********************************************************************************************************************
 * PUBLIC FUNCTIONS
 *********************************************************************************************************************/
int battery_get_voltage_mv() {
    // Get the reading from the battery thread, if it is 0, we are still initializing
    int32_t raw = atomic_get(&avg_adc_reading);
    while (raw == 0) {
        k_sleep(K_MSEC(1));
        raw = atomic_get(&avg_adc_reading);
    }

    // Convert the ADC reading to millivolts
    int32_t mv = raw;
    int res    = adc_raw_to_millivolts_dt(&adc, &mv);
    if (res) {
        LOG_ERR("Failed to convert ADC raw value to millivolts: %d", res);
        return false;
    }

    return (int)mv;
}

int battery_get_soc_percent(int bat_voltage_mv) {
    if (bat_voltage_mv > 3000) {
        return 100;
    } else if (bat_voltage_mv > 2900) {
        return 50;
    } else if (bat_voltage_mv > 2800) {
        return 5;
    } else if (bat_voltage_mv > 2500) {
        return 1;
    } else {
        return 0;
    }
}
```

## src/bluetooth.c
```c
#include "bluetooth.h"
#include "battery.h"
#include "services/battery_svc.h"
#include "services/config_svc.h"

#include <zephyr/bluetooth/bluetooth.h>
#include <zephyr/bluetooth/gatt.h>
#include <zephyr/bluetooth/hci.h>
#include <zephyr/bluetooth/uuid.h>
#include <zephyr/kernel.h>
#include <zephyr/logging/log.h>

LOG_MODULE_REGISTER(app_bluetooth);

// Advertising data
static const struct bt_data ad[] = {
    BT_DATA_BYTES(BT_DATA_FLAGS, (BT_LE_AD_GENERAL | BT_LE_AD_NO_BREDR)),  // General flags
    BT_DATA_BYTES(BT_DATA_UUID16_ALL,                                      // 16-bit UUIDs
                  BT_UUID_BATTERY_SVC_VAL),                                // Battery Service
    BT_DATA_BYTES(BT_DATA_UUID128_ALL,                                     // 128-bit UUIDs
                  BT_UUID_CONFIG_SVC_VAL),                                 // Clicker Service
};

static const struct bt_data sd[] = {
    BT_DATA(BT_DATA_NAME_COMPLETE, CONFIG_BT_DEVICE_NAME, (sizeof(CONFIG_BT_DEVICE_NAME) - 1)),
};

// Semaphores
K_SEM_DEFINE(bluetooth_ready, 1, 1);

/*********************************************************************************************************************
 * PRIVATE FUNCTIONS
 *********************************************************************************************************************/
static void on_bluetooth_ready(int err) {
    if (err) {
        LOG_ERR("on_bluetooth_ready() called with error %d", err);
    }

    k_sem_give(&bluetooth_ready);
}

/*********************************************************************************************************************
 * PUBLIC FUNCTIONS
 *********************************************************************************************************************/
int bluetooth_init() {
    LOG_INF("Initializing Bluetooth...");

    // Enable Bluetooth
    int err = bt_enable(on_bluetooth_ready);
    if (err) {
        LOG_ERR("bt_enable() returned %d", err);
        return err;
    }

    k_sem_take(&bluetooth_ready, K_FOREVER);

    // Initialize the services
    config_svc_init();
    battery_svc_init();

    // Start advertising
    err = bt_le_adv_start(BT_LE_ADV_CONN, ad, ARRAY_SIZE(ad), sd, ARRAY_SIZE(sd));
    if (err) {
        LOG_ERR("bt_le_adv_start() returned %d", err);
        return err;
    }

    LOG_INF("Bluetooth initialized OK");

    return 0;
}
```

## src/bluetooth.h
```c
#ifndef BLUETOOTH_H
#define BLUETOOTH_H

/**
 * @brief Initialize Bluetooth and start advertising.
 *
 * @retval 0 If successful.
 * @retval <0 Error code if initialization failed.
 */
int bluetooth_init();

#endif  // BLUETOOTH_H
```

## src/buttons.h
```c
#ifndef BUTTONS_H
#define BUTTONS_H

#include <stdbool.h>
#include <zephyr/kernel.h>

enum buttons_button_t {
    BUTTONS_BTN_1,
    BUTTONS_BTN_2,
    BUTTONS_BTN_3,
    BUTTONS_BTN_4,
    BUTTONS_BTN_5,
    BUTTONS_BTN_SHIFT,
};

struct buttons_event_t {
    enum buttons_button_t button;
    bool is_long_press;
    int preceding_short_shift_presses;
};

/**
 * @brief Get/wait for the next button event.
 *
 * @param event Pointer to the event structure to fill.
 * @param timeout Waiting period to obtain the next event, or one of the special
 *                values K_NO_WAIT and K_FOREVER.
 *
 * @retval 0 If successful.
 * @retval -ETIMEDOUT If the timeout expired before an event was received.
 */
int buttons_get_event(struct buttons_event_t *event, k_timeout_t timeout);

#endif  // BUTTONS_H
```

## src/config.c
```c
#include "config.h"

#include <zephyr/drivers/flash.h>
#include <zephyr/fs/nvs.h>
#include <zephyr/logging/log.h>
#include <zephyr/storage/flash_map.h>

LOG_MODULE_REGISTER(app_config);

// NVS partition
#define NVS_PARTITION        storage_partition
#define NVS_PARTITION_DEVICE FIXED_PARTITION_DEVICE(NVS_PARTITION)
#define NVS_PARTITION_OFFSET FIXED_PARTITION_OFFSET(NVS_PARTITION)
#define NVS_FS_ENTRY_ID      1

// Global state
static bool is_initialized = false;

static struct nvs_fs fs;

/*********************************************************************************************************************
 * PRIVATE FUNCTIONS
 *********************************************************************************************************************/

static int init_nvs() {
    if (is_initialized) return 0;

    if (!device_is_ready(NVS_PARTITION_DEVICE)) {
        LOG_ERR("NVS flash device is not ready");
        return -ENODEV;
    }

    struct flash_pages_info info;
    int res = flash_get_page_info_by_offs(NVS_PARTITION_DEVICE, NVS_PARTITION_OFFSET, &info);
    if (res) {
        LOG_ERR("Failed to get page info: %d", res);
        return res;
    }

    fs.flash_device = NVS_PARTITION_DEVICE;
    fs.offset       = NVS_PARTITION_OFFSET;
    fs.sector_size  = info.size;
    fs.sector_count = 3;

    res = nvs_mount(&fs);
    if (res) {
        LOG_ERR("Failed to mount NVS: %d", res);
        return res;
    }

    is_initialized = true;
    return 0;
}

/*********************************************************************************************************************
 * PUBLIC FUNCTIONS
 *********************************************************************************************************************/

int config_load(struct config_t *config) {
    // Initialize the NVS if necessary
    int res = init_nvs();
    if (res) return res;

    // Load the configuration from NVS
    res = nvs_read(&fs, NVS_FS_ENTRY_ID, config, sizeof(*config));
    if (res > 0) {
        LOG_INF("Configuration loaded from NVS (%d bytes)", res);
    } else if (res == -ENOENT) {
        LOG_WRN("Configuration not found in NVS, using default values");
        memset(config, 0, sizeof(*config));
    } else {
        LOG_ERR("Failed to read configuration from NVS: %d", res);
        return res;
    }

    return 0;
}

int config_save(const struct config_t *config) {
    // Initialize the NVS if necessary
    int res = init_nvs();
    if (res) return res;

    // Save the configuration to NVS
    res = nvs_write(&fs, NVS_FS_ENTRY_ID, config, sizeof(*config));
    if (res > 0) {
        LOG_INF("Configuration saved to NVS (%d bytes)", res);
    } else if (res == 0) {
        LOG_INF("Configuration already up-to-date, nothing written");
    } else {
        LOG_ERR("Failed to write configuration to NVS: %d", res);
        return res;
    }

    return 0;
}
```

## src/config.h
```c
#ifndef CONFIG_H
#define CONFIG_H

#include <stdint.h>

struct config_t {
    uint8_t gazell_secret_key[16];
    uint8_t gazell_pairing_addr[5];
    uint8_t gazell_packet_valid_id[3];
    uint8_t gazell_system_addr[5];
    uint8_t gazell_host_id[5];
};

/**
 * @brief Load the configuration from persistent storage.
 *
 * @param config Pointer to the configuration structure to fill.
 *
 * @retval 0 If successful.
 * @retval <0 Error code if loading the configuration failed.
 */
int config_load(struct config_t* config);

/**
 * @brief Save the configuration to persistent storage.
 *
 * @param config Pointer to the configuration structure to save.
 *
 * @retval 0 If successful.
 * @retval <0 Error code if saving the configuration failed.
 */
int config_save(const struct config_t* config);

#endif  // CONFIG_H
```
